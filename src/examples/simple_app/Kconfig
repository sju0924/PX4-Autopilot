## src/examples/simple_app/Kconfig
```kconfig
menuconfig EXAMPLES_SIMPLE_APP
	bool "simple_app"
	default n
	---help---
		Enable support for simple_app
```

## src/modules/integrity_tools/Kconfig
```kconfig
menuconfig MODULES_INTEGRITY_TOOLS
	bool "integrity_tools"
	default n
	---help---
		Enable support for integrity_tools
```
